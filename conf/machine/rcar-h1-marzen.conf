## conf/machine/rcar-h1-marzen.conf
```bitbake
#@TYPE: Machine
#@NAME: rcar-h1-marzen

#@DESCRIPTION: Machine configuration for Renesas R-Car H1 Marzen systems


# Ship all kernel modules by default
MACHINE_EXTRA_RRECOMMENDS = " kernel-modules"

EXTRA_IMAGEDEPENDS += "u-boot"

include conf/machine/include/tune-cortexa9.inc

IMAGE_FSTYPES += "tar.bz2 jffs2"
EXTRA_IMAGECMD_jffs2 = "-lnp "

SERIAL_CONSOLE = "115200 ttyO2"

PREFERRED_PROVIDER_virtual/kernel ?= "linux-yocto"
PREFERRED_VERSION_linux-yocto ?= "3.4%"

KERNEL_IMAGETYPE = "uImage"

UBOOT_MACHINE = "marzen_config"
UBOOT_ENTRYPOINT = "0x60008000"
UBOOT_LOADADDRESS = "0x60008000"

MACHINE_FEATURES = "apm usbgadget usbhost vfat alsa"
```
